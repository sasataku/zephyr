## drivers/can/Kconfig.sccan
```kconfig
# Space Cubics CAN configuration options

# Copyright (c) 2023 Space Cubics,LLC
# SPDX-License-Identifier: Apache-2.0

config CAN_SCCAN
	bool "Space Cubics CAN Driver"
	default y
	depends on DT_HAS_SC_CAN_ENABLED
	help
	  Enable Space Cubics CAN Driver.

config CAN_SCCAN_MAX_FILTER
	int "Maximum number of acceptance filters"
	depends on CAN_SCCAN
	default 4
	range 1 4
	help
	  Defines the array size of the callback/msgq pointers.
```

## dts/bindings/can/sc,can.yaml
```yaml
description: Space Cubics CAN controller

compatible: "sc,can"

include: [can-controller.yaml]

properties:
  reg:
    required: true

  interrupts:
    required: true

  sample-point:
    required: true

  clock-frequency:
    type: int
    description: Clock frequency information for CAN
    required: true
```
